## boards/lowrisc/ibex_demo_system/Kconfig.ibex_demo_system
```kconfig
# SPDX-License-Identifier: Apache-2.0

config BOARD_IBEX_DEMO_SYSTEM
	select SOC_IBEX
```

## boards/lowrisc/ibex_demo_system/ibex_demo_system_defconfig
```kconfig
# SPDX-License-Identifier: Apache-2.0

CONFIG_XIP=n
CONFIG_SERIAL=y
CONFIG_CONSOLE=y
CONFIG_UART_CONSOLE=y
CONFIG_BUILD_OUTPUT_BIN=y
```

## drivers/serial/Kconfig.ibex
```kconfig
# SPDX-License-Identifier: Apache-2.0

config UART_IBEX
	bool "Ibex UART"
	default y
	depends on DT_HAS_LOWRISC_IBEX_UART_ENABLED
	depends on !SERIAL_SUPPORT_INTERRUPT
	select SERIAL_HAS_DRIVER
	help
	  Enable Ibex UART serial driver
```

## dts/bindings/serial/lowrisc,ibex-uart.yaml
```yaml
# SPDX-License-Identifier: Apache-2.0

description: Ibex UART

compatible: "lowrisc,ibex-uart"

include: [uart-controller.yaml]

properties:
  reg:
    required: true
```

## dts/bindings/timer/lowrisc,ibex-machine-timer.yaml
```yaml
# SPDX-License-Identifier: Apache-2.0

description: |
  Ibex Machine Timer

  The Ibex machine timer provides RISC-V privileged mtime and mtimecmp
  registers.

compatible: "lowrisc,ibex-machine-timer"

include: base.yaml

properties:
  reg:
    required: true

  interrupts:
    required: true
```

## soc/lowrisc/ibex/Kconfig.defconfig
```kconfig
# SPDX-License-Identifier: Apache-2.0

if SOC_IBEX

config SYS_CLOCK_HW_CYCLES_PER_SEC
	default 50000000

config RISCV_SOC_INTERRUPT_INIT
	default y

config NUM_IRQS
	default 32

endif # SOC_IBEX
```

## soc/lowrisc/ibex/Kconfig.soc
```kconfig
# SPDX-License-Identifier: Apache-2.0

config SOC_IBEX
	bool

config SOC
	default "ibex" if SOC_IBEX
```
